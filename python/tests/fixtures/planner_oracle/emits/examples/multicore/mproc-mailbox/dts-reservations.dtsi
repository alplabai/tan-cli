/*
 * Auto-generated by scripts/alp_orchestrate.py -- do not edit.
 * Regenerate after changes to board.yaml `ipc:` or the SoM's
 * memory_map block.  #include this file from your kernel /
 * Zephyr DT.
 */

/ {
    reserved-memory {
        #address-cells = <2>;
        #size-cells = <2>;

        alp_shmem0: alp_shmem0@23ef000 {
            compatible = "shared-dma-pool";
            reg = <0x0 0x023ef000 0x0 0x00001000>;
            no-map;
            label = "alp_shmem0";
        };

    };
};
