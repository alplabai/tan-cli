/*
 * Auto-generated by scripts/alp_orchestrate.py -- do not edit.
 * Regenerate after changes to board.yaml `ipc:` or the SoM's
 * memory_map block.  #include this file from your kernel /
 * Zephyr DT.
 */

/ {
    reserved-memory {
        #address-cells = <2>;
        #size-cells = <2>;

        /* BLOCKED: alp_default_rpmsg -- ipc entry 'alp_default_rpmsg' endpoints ['a32_cluster', 'm55_hp'] only match memory_map region(s) in SoM E1M-AEN801 that are ineligible for an IPC carve-out: 'mram_main' (region 'mram_main' [0x80000000, 0x80580000) is flash-class (contained in the SoC's declared on-die MRAM aperture) -- not safe as an IPC carve-out target).  Add a region whose resolved base sits outside the SoC's declared MRAM aperture (and, if the SoM preset authors the row itself, carries `write_authority: customer_runtime`) to metadata/e1m_modules/E1M-AEN801.yaml, or remove the matching ipc entry from board.yaml. */

    };
};
