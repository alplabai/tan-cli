/*
 * Auto-generated by scripts/alp_orchestrate.py -- do not edit.
 * Regenerate after changes to board.yaml `ipc:` or the SoM's
 * memory_map block.  #include this file from your kernel /
 * Zephyr DT.
 */

/ {
    reserved-memory {
        #address-cells = <2>;
        #size-cells = <2>;

        alp_default_rpmsg: alp_default_rpmsg@10000 {
            compatible = "shared-dma-pool";
            reg = <0x0 0x00010000 0x0 0x00080000>;
            no-map;
            label = "alp_default_rpmsg";
        };

    };
};
